## Kconfig
```kconfig
# Copyright 2024-2025 NXP
#
# SPDX-License-Identifier: BSD-3-Clause

menuconfig MCUX_COMPONENT_middleware.wireless.ieee_802_15_4
    bool "ieee 802.15.4"
    help
       Enable ieee 802.15.4 MAC/PHY


if MCUX_COMPONENT_middleware.wireless.ieee_802_15_4

# Hidden config for internal usage
# This generic PHY config is used to gather dependencies and to compile PHY files
config MCUX_COMPONENT_middleware.wireless.ieee_802_15_4.generic_PHY
    bool
    select MCUX_COMPONENT_driver.ltc
    select MCUX_COMPONENT_component.messaging
    select MCUX_COMPONENT_middleware.wireless.xcvr
    select MCUX_COMPONENT_component.mem_manager
    select MCUX_COMPONENT_middleware.wireless.framework.function_lib
    select MCUX_COMPONENT_component.osa
    imply MCUX_COMPONENT_middleware.wireless.framework.mws
    imply MCUX_COMPONENT_middleware.wireless.framework.platform.genfsk

# This generic NBU PHY config is used to gather dependencies and compile NBU platform PHY files.
config MCUX_COMPONENT_middleware.wireless.ieee_802_15_4.generic_PHY.NBU
    bool
    select MCUX_COMPONENT_middleware.wireless.ieee_802_15_4.generic_PHY
    select MCUX_COMPONENT_middleware.wireless.framework.seclib_rng

# mcxw70
config MCUX_COMPONENT_middleware.wireless.ieee_802_15_4.mcxw70.PHY
    bool
    depends on MCUX_PRJSEG_middleware.wireless.framework.platform.kw43_mcxw70 && \
               MCUX_COMPONENT_middleware.wireless.ieee_802_15_4.PHY
    select MCUX_COMPONENT_middleware.wireless.xcvr

config MCUX_COMPONENT_middleware.wireless.ieee_802_15_4.mcxw70.split_PHY
    bool
    depends on MCUX_PRJSEG_middleware.wireless.framework.platform.kw43_mcxw70 && \
               MCUX_COMPONENT_middleware.wireless.ieee_802_15_4.split_PHY
    select MCUX_COMPONENT_middleware.wireless.framework.seclib_rng

# k32w1_mcxw71
config MCUX_COMPONENT_middleware.wireless.ieee_802_15_4.k32w1_mcxw71.PHY
    bool
    depends on MCUX_PRJSEG_middleware.wireless.framework.platform.kw45_k32w1_mcxw71 && \
               MCUX_COMPONENT_middleware.wireless.ieee_802_15_4.PHY

config MCUX_COMPONENT_middleware.wireless.ieee_802_15_4.k32w1_mcxw71.MAC
    bool
    depends on MCUX_PRJSEG_middleware.wireless.framework.platform.kw45_k32w1_mcxw71 && \
               MCUX_COMPONENT_middleware.wireless.ieee_802_15_4.MAC
    select MCUX_COMPONENT_middleware.wireless.xcvr
    select MCUX_COMPONENT_middleware.wireless.framework.platform.genfsk

config MCUX_COMPONENT_middleware.wireless.ieee_802_15_4.k32w1_mcxw71.MAC_split_PHY
    bool
    depends on MCUX_PRJSEG_middleware.wireless.framework.platform.kw45_k32w1_mcxw71 && \
               MCUX_COMPONENT_middleware.wireless.ieee_802_15_4.MAC_split_PHY
    select MCUX_COMPONENT_middleware.wireless.framework.seclib_rng

config MCUX_COMPONENT_middleware.wireless.ieee_802_15_4.k32w1_mcxw71.split_PHY
    bool
    depends on MCUX_PRJSEG_middleware.wireless.framework.platform.kw45_k32w1_mcxw71 && \
               MCUX_COMPONENT_middleware.wireless.ieee_802_15_4.split_PHY
    select MCUX_COMPONENT_middleware.wireless.framework.seclib_rng

config MCUX_COMPONENT_middleware.wireless.ieee_802_15_4.k32w1_mcxw71.split_MAC
    bool
    depends on MCUX_PRJSEG_middleware.wireless.framework.platform.kw45_k32w1_mcxw71 && \
               MCUX_COMPONENT_middleware.wireless.ieee_802_15_4.split_MAC
    select MCUX_COMPONENT_middleware.wireless.framework.seclib_rng

config MCUX_COMPONENT_middleware.wireless.ieee_802_15_4.k32w1_mcxw71.NBU_img
    bool
    depends on MCUX_PRJSEG_middleware.wireless.framework.platform.kw45_k32w1_mcxw71 && \
                (MCUX_COMPONENT_middleware.wireless.ieee_802_15_4.MAC_split_PHY || \
                 MCUX_COMPONENT_middleware.wireless.ieee_802_15_4.split_PHY || \
                 MCUX_COMPONENT_middleware.wireless.ieee_802_15_4.split_MAC)

# mcxw71_nbu
config MCUX_COMPONENT_middleware.wireless.ieee_802_15_4.k32w1_mcxw71_nbu.PHY
    bool
    depends on MCUX_PRJSEG_middleware.wireless.framework.platform.kw45_mcxw71_nbu
    select MCUX_COMPONENT_middleware.wireless.ieee_802_15_4.generic_PHY.NBU

# MAC NBU libs are built without the PHY files. k32w1_mcxw71_nbu.PHY is selected to add the PHY.
config MCUX_COMPONENT_middleware.wireless.ieee_802_15_4.k32w1_mcxw71_nbu.MAC
    bool
    depends on MCUX_PRJSEG_middleware.wireless.framework.platform.kw45_mcxw71_nbu && \
               MCUX_COMPONENT_middleware.wireless.ieee_802_15_4.MAC
    select MCUX_COMPONENT_middleware.wireless.ieee_802_15_4.k32w1_mcxw71_nbu.PHY

# mcxw72
config MCUX_COMPONENT_middleware.wireless.ieee_802_15_4.mcxw72.PHY
    bool
    depends on MCUX_PRJSEG_middleware.wireless.framework.platform.kw47_mcxw72 && \
               MCUX_COMPONENT_middleware.wireless.ieee_802_15_4.PHY

config MCUX_COMPONENT_middleware.wireless.ieee_802_15_4.mcxw72.MAC
    bool
    depends on MCUX_PRJSEG_middleware.wireless.framework.platform.kw47_mcxw72 && \
               MCUX_COMPONENT_middleware.wireless.ieee_802_15_4.MAC
    select MCUX_COMPONENT_middleware.wireless.xcvr
    select MCUX_COMPONENT_middleware.wireless.framework.platform.genfsk

config MCUX_COMPONENT_middleware.wireless.ieee_802_15_4.mcxw72.MAC_split_PHY
    bool
    depends on MCUX_PRJSEG_middleware.wireless.framework.platform.kw47_mcxw72 && \
               MCUX_COMPONENT_middleware.wireless.ieee_802_15_4.MAC_split_PHY
    select MCUX_COMPONENT_middleware.wireless.framework.seclib_rng

config MCUX_COMPONENT_middleware.wireless.ieee_802_15_4.mcxw72.split_PHY
    bool
    depends on MCUX_PRJSEG_middleware.wireless.framework.platform.kw47_mcxw72 && \
               MCUX_COMPONENT_middleware.wireless.ieee_802_15_4.split_PHY
    select MCUX_COMPONENT_middleware.wireless.framework.seclib_rng

config MCUX_COMPONENT_middleware.wireless.ieee_802_15_4.mcxw72.split_MAC
    bool
    depends on MCUX_PRJSEG_middleware.wireless.framework.platform.kw47_mcxw72 && \
               MCUX_COMPONENT_middleware.wireless.ieee_802_15_4.split_MAC
    select MCUX_COMPONENT_middleware.wireless.framework.seclib_rng

config MCUX_COMPONENT_middleware.wireless.ieee_802_15_4.mcxw72.NBU_img
    bool
    depends on MCUX_PRJSEG_middleware.wireless.framework.platform.kw47_mcxw72 && \
                (MCUX_COMPONENT_middleware.wireless.ieee_802_15_4.MAC_split_PHY || \
                 MCUX_COMPONENT_middleware.wireless.ieee_802_15_4.split_PHY || \
                 MCUX_COMPONENT_middleware.wireless.ieee_802_15_4.split_MAC)


# mcxw72_nbu
config MCUX_COMPONENT_middleware.wireless.ieee_802_15_4.mcxw72_nbu.PHY
    bool
    depends on MCUX_PRJSEG_middleware.wireless.framework.platform.kw47_mcxw72_nbu
    select MCUX_COMPONENT_middleware.wireless.ieee_802_15_4.generic_PHY.NBU

# MAC NBU libs are built without the PHY files. mcxw72_nbu.PHY is selected to add the PHY.
config MCUX_COMPONENT_middleware.wireless.ieee_802_15_4.mcxw72_nbu.MAC
    bool
    depends on MCUX_PRJSEG_middleware.wireless.framework.platform.kw47_mcxw72_nbu && \
               MCUX_COMPONENT_middleware.wireless.ieee_802_15_4.MAC
    select MCUX_COMPONENT_middleware.wireless.ieee_802_15_4.mcxw72_nbu.PHY

# rw61x
config MCUX_COMPONENT_middleware.wireless.ieee_802_15_4.rw61x.split_MAC
    bool
    depends on MCUX_PRJSEG_middleware.wireless.framework.platform.rw61x && \
               MCUX_COMPONENT_middleware.wireless.ieee_802_15_4.split_MAC

choice MCUX_COMPONENT_middleware.wireless.ieee_802_15_4.selection
    prompt "ieee 802.15.4 MAC/PHY"

config MCUX_COMPONENT_middleware.wireless.ieee_802_15_4.PHY
    bool "PHY only on main core"
    depends on MCUX_PRJSEG_middleware.wireless.framework.platform.kw43_mcxw70 || \
               MCUX_PRJSEG_middleware.wireless.framework.platform.kw45_k32w1_mcxw71 || \
               MCUX_PRJSEG_middleware.wireless.framework.platform.kw47_mcxw72 || \
               MCUX_PRJSEG_middleware.wireless.framework.platform.kw47_mcxw72_nbu || \
               MCUX_PRJSEG_middleware.wireless.framework.platform.kw45_mcxw71_nbu
    select MCUX_COMPONENT_middleware.wireless.ieee_802_15_4.mcxw70.PHY \
           if MCUX_PRJSEG_middleware.wireless.framework.platform.kw43_mcxw70
    select MCUX_COMPONENT_middleware.wireless.ieee_802_15_4.k32w1_mcxw71.PHY \
           if MCUX_PRJSEG_middleware.wireless.framework.platform.kw45_k32w1_mcxw71
    select MCUX_COMPONENT_middleware.wireless.ieee_802_15_4.mcxw72.PHY \
           if MCUX_PRJSEG_middleware.wireless.framework.platform.kw47_mcxw72
    select MCUX_COMPONENT_middleware.wireless.ieee_802_15_4.mcxw72_nbu.PHY \
           if MCUX_PRJSEG_middleware.wireless.framework.platform.kw47_mcxw72_nbu
    select MCUX_COMPONENT_middleware.wireless.ieee_802_15_4.k32w1_mcxw71_nbu.PHY \
           if MCUX_PRJSEG_middleware.wireless.framework.platform.kw45_mcxw71_nbu
    select MCUX_COMPONENT_middleware.wireless.ieee_802_15_4.generic_PHY

config MCUX_COMPONENT_middleware.wireless.ieee_802_15_4.MAC
    bool "MAC/PHY on main core"
    depends on MCUX_PRJSEG_middleware.wireless.framework.platform.kw45_k32w1_mcxw71 || \
               MCUX_PRJSEG_middleware.wireless.framework.platform.kw45_mcxw71_nbu || \
               MCUX_PRJSEG_middleware.wireless.framework.platform.kw47_mcxw72_nbu || \
               MCUX_PRJSEG_middleware.wireless.framework.platform.kw47_mcxw72
    select MCUX_COMPONENT_middleware.wireless.ieee_802_15_4.k32w1_mcxw71.MAC \
           if MCUX_PRJSEG_middleware.wireless.framework.platform.kw45_k32w1_mcxw71
    select MCUX_COMPONENT_middleware.wireless.ieee_802_15_4.k32w1_mcxw71_nbu.MAC \
           if MCUX_PRJSEG_middleware.wireless.framework.platform.kw45_mcxw71_nbu
    select MCUX_COMPONENT_middleware.wireless.ieee_802_15_4.mcxw72_nbu.MAC \
           if MCUX_PRJSEG_middleware.wireless.framework.platform.kw47_mcxw72_nbu
    select MCUX_COMPONENT_middleware.wireless.ieee_802_15_4.mcxw72.MAC \
           if MCUX_PRJSEG_middleware.wireless.framework.platform.kw47_mcxw72
    select MCUX_COMPONENT_driver.ltc

config MCUX_COMPONENT_middleware.wireless.ieee_802_15_4.MAC_split_PHY
    bool "MAC on main core, PHY on NBU core"
    depends on MCUX_PRJSEG_middleware.wireless.framework.platform.kw45_k32w1_mcxw71 || \
               MCUX_PRJSEG_middleware.wireless.framework.platform.kw47_mcxw72
    select MCUX_COMPONENT_middleware.wireless.ieee_802_15_4.k32w1_mcxw71.MAC_split_PHY \
           if MCUX_PRJSEG_middleware.wireless.framework.platform.kw45_k32w1_mcxw71
    select MCUX_COMPONENT_middleware.wireless.ieee_802_15_4.mcxw72.MAC_split_PHY \
           if MCUX_PRJSEG_middleware.wireless.framework.platform.kw47_mcxw72
    select MCUX_COMPONENT_middleware.wireless.ieee_802_15_4.k32w1_mcxw71.NBU_img \
           if MCUX_PRJSEG_middleware.wireless.framework.platform.kw45_k32w1_mcxw71
    select MCUX_COMPONENT_middleware.wireless.ieee_802_15_4.mcxw72.NBU_img \
           if MCUX_PRJSEG_middleware.wireless.framework.platform.kw47_mcxw72

config MCUX_COMPONENT_middleware.wireless.ieee_802_15_4.split_PHY
    bool "PHY only on NBU core"
    depends on MCUX_PRJSEG_middleware.wireless.framework.platform.kw43_mcxw70 || \
               MCUX_PRJSEG_middleware.wireless.framework.platform.kw45_k32w1_mcxw71 || \
               MCUX_PRJSEG_middleware.wireless.framework.platform.kw47_mcxw72
    select MCUX_COMPONENT_middleware.wireless.ieee_802_15_4.mcxw70.split_PHY \
           if MCUX_PRJSEG_middleware.wireless.framework.platform.kw43_mcxw70
    select MCUX_COMPONENT_middleware.wireless.ieee_802_15_4.k32w1_mcxw71.split_PHY \
           if MCUX_PRJSEG_middleware.wireless.framework.platform.kw45_k32w1_mcxw71
    select MCUX_COMPONENT_middleware.wireless.ieee_802_15_4.mcxw72.split_PHY \
           if MCUX_PRJSEG_middleware.wireless.framework.platform.kw47_mcxw72
    select MCUX_COMPONENT_middleware.wireless.ieee_802_15_4.k32w1_mcxw71.NBU_img \
           if MCUX_PRJSEG_middleware.wireless.framework.platform.kw45_k32w1_mcxw71
    select MCUX_COMPONENT_middleware.wireless.ieee_802_15_4.mcxw72.NBU_img \
           if MCUX_PRJSEG_middleware.wireless.framework.platform.kw47_mcxw72

config MCUX_COMPONENT_middleware.wireless.ieee_802_15_4.split_MAC
    bool "MAC/PHY on NBU core"
    depends on MCUX_PRJSEG_middleware.wireless.framework.platform.kw45_k32w1_mcxw71 || \
               MCUX_PRJSEG_middleware.wireless.framework.platform.kw47_mcxw72 || \
               MCUX_PRJSEG_middleware.wireless.framework.platform.rw61x
    select MCUX_COMPONENT_middleware.wireless.ieee_802_15_4.k32w1_mcxw71.split_MAC \
           if MCUX_PRJSEG_middleware.wireless.framework.platform.kw45_k32w1_mcxw71
    select MCUX_COMPONENT_middleware.wireless.ieee_802_15_4.mcxw72.split_MAC \
           if MCUX_PRJSEG_middleware.wireless.framework.platform.kw47_mcxw72
    select MCUX_COMPONENT_middleware.wireless.ieee_802_15_4.rw61x.split_MAC \
           if MCUX_PRJSEG_middleware.wireless.framework.platform.rw61x
    select MCUX_COMPONENT_middleware.wireless.ieee_802_15_4.k32w1_mcxw71.NBU_img \
           if MCUX_PRJSEG_middleware.wireless.framework.platform.kw45_k32w1_mcxw71
    select MCUX_COMPONENT_middleware.wireless.ieee_802_15_4.mcxw72.NBU_img \
           if MCUX_PRJSEG_middleware.wireless.framework.platform.kw47_mcxw72

config MCUX_COMPONENT_middleware.wireless.ieee_802_15_4.interface
    bool "ieee 802.15.4 MAC/PHY interface"

endchoice

endif
```
